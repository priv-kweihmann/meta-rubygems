## conf/layer.conf
```bitbake
BBPATH =. "${LAYERDIR}:"

BBFILES += "\
            ${LAYERDIR}/images/*.bb \
            ${LAYERDIR}/packagegroups-rubygems/*.bb \
            ${LAYERDIR}/recipes-devtools/*.bb \
            ${LAYERDIR}/recipes-devtools/*.bbappend \
            ${LAYERDIR}/recipes-rubygems/*.bb \
            ${LAYERDIR}/recipes-stdgems/*.bb \
           "

BBFILES_DYNAMIC += "\
    clang-layer:${LAYERDIR}/dynamic-layers/meta-clang/*.bb \
    clang-layer:${LAYERDIR}/dynamic-layers/meta-clang/*.bbappend \
"

BBFILE_COLLECTIONS += "rubygems"
BBFILE_PATTERN_rubygems = "^${LAYERDIR}/"

LAYERVERSION_rubygems = "1"
LAYERDEPENDS_rubygems = "core openembedded-layer"

LAYERSERIES_COMPAT_rubygems = "langdale kirkstone honister"

LICENSE_PATH += "${LAYERDIR}/files/licenses/"
RUBYGEMS_LAYERDIR = "${LAYERDIR}"
```
